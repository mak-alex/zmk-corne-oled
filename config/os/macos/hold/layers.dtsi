to_mBAS_kp: to_mBAS_kp {
    compatible = "zmk,behavior-hold-tap";
    #binding-cells = <2>;
    tapping-term-ms = <HP_TAPPING>;
    flavor = "hold-preferred";
    bindings = <&to_mBAS>, <&kp>;
};

MOTO_HOLD(m, AXN, BAS, FNK) //mo_mAXNwBAS_to_mFNK
MOTO_HOLD(m, AXN, BAS, AXN) //mo_mAXNwBAS_to_mAXN
MOTO_HOLD(m, DEV, BAS, DEV) //mo_mDEVwBAS_to_mDEV
MOTO_HOLD(m, AXN, DEV, BAS) //mo_mAXNwDEV_to_mBAS
MOTO_HOLD(m, AXN, DEV, AXN) //mo_mAXNwDEV_to_mAXN
MOTO_HOLD(m, FNK, AXN, FNK) //mo_mFNKwAXN_to_mFNK
